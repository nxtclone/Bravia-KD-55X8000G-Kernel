/*
 * ARM Ltd.
 *
 * ARMv8 Foundation model DTS
 */

/dts-v1/;
/plugin/;

/ {
    fragment@0 {
        target = <&cpufreq_opp>;
        __overlay__ {
            compatible = "mediatek,mt53xx-cpufreq";
            operating-points = <
                    /* KHz    uV */
                    1500000 1125000
                    1296000 1080000
                    1032000 1000000
            >;
        };
    };
};

